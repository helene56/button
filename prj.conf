## prj.conf
```kconfig
CONFIG_GPIO=y
CONFIG_INPUT=y
CONFIG_INPUT_MODE_SYNCHRONOUS=y
CONFIG_BUILD_OUTPUT_UF2=y
```

## boards/promicro.overlay
```dts
#include <zephyr/dt-bindings/input/input-event-codes.h>

/ {
	aliases {
		keyboard = &kbd0;
		// row1 = &button0;
		// row2 = &button1;
		// row3 = &button2;

		// cola = &col_a;
		// colb = &col_b;
		// colc = &col_c;
	};

	// buttons {
	// 	compatible = "gpio-keys";

	// 	button0: button_0 {
	// 		label = "Row 1";
	// 		gpios = <&gpio0 20 (GPIO_PULL_UP | GPIO_ACTIVE_LOW)>;
	// 		zephyr,code = <INPUT_KEY_0>;
	// 	};

	// 	button1: button_1 {
	// 		label = "Row 2";
	// 		gpios = <&gpio0 24 (GPIO_PULL_UP | GPIO_ACTIVE_LOW)>;
	// 		zephyr,code = <INPUT_KEY_1>;
	// 	};

	// 	button2: button_2 {
	// 		label = "Row 3";
	// 		gpios = <&gpio1 6 (GPIO_PULL_UP | GPIO_ACTIVE_LOW)>;
	// 		zephyr,code = <INPUT_KEY_2>;
	// 	};
	// };

	// gpio_outputs {
	// 	compatible = "gpio-leds";

	// 	col_a: col_a {
	// 		gpios = <&gpio0 22 GPIO_ACTIVE_LOW>;
	// 		label = "Col A";
	// 	};

	// 	col_b: col_b {
	// 		gpios = <&gpio0 11 GPIO_ACTIVE_LOW>;
	// 		label = "Col B";
	// 	};

	// 	col_c: col_c {
	// 		gpios = <&gpio1 4 GPIO_ACTIVE_LOW>;
	// 		label = "Col C";
	// 	};
	// };

	kbd0: kbd_matrix {
		compatible = "gpio-kbd-matrix";
		row-gpios = <&gpio0 20 (GPIO_PULL_UP | GPIO_ACTIVE_LOW)>,
					<&gpio0 24 (GPIO_PULL_UP | GPIO_ACTIVE_LOW)>,
					<&gpio1 6 (GPIO_PULL_UP | GPIO_ACTIVE_LOW)>;
		col-gpios = <&gpio0 22 GPIO_ACTIVE_LOW>,
					<&gpio0 11 GPIO_ACTIVE_LOW>,
					<&gpio1 4 GPIO_ACTIVE_LOW>;
		no-ghostkey-check;
	};

};
```

## src/main.c
```c
#include <zephyr/device.h>
#include <zephyr/drivers/gpio.h>
#include <zephyr/input/input.h>
#include <zephyr/kernel.h>
#include <zephyr/sys/printk.h>

#define KBD_NODE DT_ALIAS(keyboard)

#if !DT_NODE_HAS_STATUS_OKAY(KBD_NODE)
#error "keyboard alias is not defined"
#endif

#define KBD_DEV DEVICE_DT_GET(KBD_NODE)

static struct gpio_dt_spec led = GPIO_DT_SPEC_GET_OR(DT_ALIAS(led0), gpios, {0});

static void kbd_cb(struct input_event *evt, void *user_data)
{
	static int row;
	static int col;
	static int pressed;

	ARG_UNUSED(user_data);

	switch (evt->code) {
	case INPUT_ABS_X:
		col = evt->value;
		break;
	case INPUT_ABS_Y:
		row = evt->value;
		break;
	case INPUT_BTN_TOUCH:
		pressed = evt->value;
		break;
	default:
		return;
	}

	if (!evt->sync) {
		return;
	}

	printk("row=%d col=%d %s\n", row, col, pressed ? "pressed" : "released");

	if (pressed && led.port != NULL) {
		gpio_pin_toggle_dt(&led);
	}
}

INPUT_CALLBACK_DEFINE(KBD_DEV, kbd_cb, NULL);

int main(void)
{
	const struct device *kbd = KBD_DEV;
	int ret;

	if (!device_is_ready(kbd)) {
		printk("Keyboard device %s is not ready\n", kbd->name);
		return 0;
	}

	if (led.port != NULL) {
		if (!gpio_is_ready_dt(&led)) {
			printk("LED GPIO device is not ready\n");
			led.port = NULL;
		} else {
			ret = gpio_pin_configure_dt(&led, GPIO_OUTPUT_INACTIVE);
			if (ret != 0) {
				printk("Failed to configure LED: %d\n", ret);
				led.port = NULL;
			}
		}
	}

	printk("Keyboard matrix input started on %s\n", kbd->name);

	while (1) {
		k_msleep(1000);
	}

	return 0;
}
```
